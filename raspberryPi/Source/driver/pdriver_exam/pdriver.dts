/dts-v1/;
/plugin/;

/ {
    compatible = "brcm,bcm2708";
    fragment@0 {
        target-path = "/";
        __overlay__ {
            status = "okay";
            pdriver: pdriver{
                compatible = "pdriver";
                status = "okay";
            };
        };
    };
};		

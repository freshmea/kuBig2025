/dts-v1/;
/plugin/;

/ {
    compatible = "brcm,bcm2708";

    fragment@0 {
		target = <&i2c1>;
		__overlay__ {
			#address-cells = <1>;
			#size-cells = <0>;
			status = "okay";

			pca9685_test: pca9685_test{
				compatible = "pca9685_test";
				reg = <0x5e>;
			};
		};
    };
};

